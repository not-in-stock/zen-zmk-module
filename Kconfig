## Kconfig
```kconfig
menu "Zen ZMK module"

rsource "drivers/Kconfig"

config ZEN_DISPLAY_FULL_REFRESH_PERIOD
    int "(Zen) Full display refresh period in seconds"
    default 0
    depends on ZMK_DISPLAY
    help
      Period in seconds between full-screen LVGL invalidations.
      Useful for e-ink/EPD displays that accumulate ghosting artifacts
      after repeated partial refreshes. Set to 0 to disable.

config ZMK_DISPLAY_HIDE_MOMENTARY_LAYERS
    bool "Do not update layer widget for momentary layer changes"
    depends on ZMK_DISPLAY
    select ZMK_TRACK_MOMENTARY_LAYERS
    help
      Skip layer-widget redraws when only momentary (&mo) layers change.
      Reduces churn on slow-refresh displays. Requires the
      ZMK_TRACK_MOMENTARY_LAYERS core feature (auto-selected).

endmenu
```
